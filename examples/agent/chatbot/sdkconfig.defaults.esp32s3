## examples/agent/chatbot/sdkconfig.defaults.esp32s3
```kconfig
CONFIG_SR_WN_WN9_HIESP=y
CONFIG_ESPTOOLPY_FLASHSIZE="16MB"
CONFIG_PARTITION_TABLE_CUSTOM=y
CONFIG_PARTITION_TABLE_CUSTOM_FILENAME="partitions_16m.csv"
CONFIG_ESP_BOARD_ESP_VOCAT_BOARD_V1_2=y
CONFIG_SPIRAM=y
CONFIG_SPIRAM_MODE_OCT=y
CONFIG_SPIRAM_SPEED_80M=y
```
